// Import required libraries

#include <Wire.h>
#include <Adafruit_GFX.h>
#include <Adafruit_SSD1306.h>

#include "WiFi.h"
#include "ESPAsyncWebServer.h"


// Replace with your network credentials
const char* ssid = "vodafoneFD30";
const char* password = "R2MHRTMGTNJZGK";

#define A  16   //Puerto de salida conectado al pin A del CD4052
#define B  17   //Puerto de salida conectado al pin B del CD4052
#define Ampli 18 // - Puerto de salida que enciende y apaga el amplificador
#define Bt    19 //TX - Puerto de salida que enciende y apaga el modulo Bluetooth

#define btn_ampli 23
#define btn_bt 25
#define btn_device 26
//SDA 21
//SCL 22

#define SCREEN_WIDTH 128 // OLED display width, in pixels
#define SCREEN_HEIGHT 64 // OLED display height, in pixels
Adafruit_SSD1306 display(SCREEN_WIDTH, SCREEN_HEIGHT, &Wire,-1);

// Create AsyncWebServer object on port 80
AsyncWebServer server(80);

//Configuración por defecto; variables globales
boolean change = false;
String device = "PC"; 
String ampli = "OFF";
String bt = "OFF";

const unsigned char CrayfeLogo[] PROGMEM = {
0x00, 0x00, 0x00, 0x00, 0x00, 0x00, 0x00, 0x00, 0x00, 0x1f, 0x80, 0x00, 0x00, 0x00, 0x00, 0x00, 
0x04, 0x7c, 0x00, 0x00, 0x00, 0x00, 0x00, 0x00, 0x00, 0x7f, 0x80, 0x00, 0x03, 0xc0, 0x00, 0x00, 
0x1e, 0xff, 0x00, 0x00, 0x00, 0x00, 0x00, 0x00, 0x00, 0xfc, 0x00, 0x00, 0x03, 0xe0, 0x00, 0x00, 
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0x00, 0x00, 0x00, 0x00, 0x00, 0x00, 0x00, 0x00, 0x00, 0x00, 0x7f, 0xc0, 0x00, 0x00, 0x00, 0x00
};
const char index_html[] PROGMEM = R"rawliteral(
<!DOCTYPE html>
<html>
    <head>
        <meta http-equiv="Content-Type" content="text/html"; charset="UTF-8" />
        <meta name="viewport" content="width=device-width, initial-scale=1">
        <link rel="icon" href="data:,">
        <link href="https://fonts.googleapis.com/css?family=Cabin+Sketch&display=swap" rel="stylesheet">
        <link href="https://fonts.googleapis.com/css?family=VT323&display=swap" rel="stylesheet">
        <link href="https://fonts.googleapis.com/css2?family=Black+Ops+One&display=swap" rel="stylesheet">
        <style>
            body {background-image: url(https://i.ibb.co/rv44vFj/wood.jpg);background-attachment: fixed;background-repeat: no-repeat;background-size: cover; text-align: center;font-family: 'Cabin Sketch', cursive;}
            .header{padding: 0px; width:400px; height:150px;}
            .testInput{padding: 15px; width:400px;}
            .logo{float:left; padding: 30px 10px 20px 20px;}
            .title-header{font-family: 'Black Ops One', cursive; font-size: 40px; color: black;}
            .wrap{padding:20px;width: 470px;margin-right: auto; margin-left: auto;display: inline-block;}
            .content{background-image: url(https://i.ibb.co/H2k5kdP/papel.jpg); padding: 5px 20px 20px 20px; margin-top: 20px;}
            .button{background-color: #195B6A; border: none; color: white; padding: 16px 20px; font-family: 'VT323', monospace;text-decoration: none; font-size: 20px; margin: 2px; cursor: pointer;}
            .button1{background-color: #F33319; border: none; color: white; padding: 16px 20px; font-family: 'VT323', monospace;text-decoration: none; font-size: 20px; margin: 2px; cursor: pointer;}
            .button2{background-color: #9AFF40; border: none; color: white; padding: 16px 20px; font-family: 'VT323', monospace;text-decoration: none; font-size: 20px; margin: 2px; cursor: pointer;}
            .input_text{color: black; padding: 16px;text-decoration: none; font-size: 20px; margin: 2px; cursor: pointer;}
            .separator{border-color: #000;}
        </style>
    </head>

<body> 
    <div class="wrap">
    <div class="content">
        <div class="header">
            <h1 class="title-header">Crayfe's Sound Manager</h1></p>
        </div>
        <hr class="separator"/>
            <div class="testInput">
            <p><h2 style="font-family: 'Cabin Sketch';">General</h2></p>
            <p style="font-family: 'Cabin Sketch'; font-size: 15px;"><b>Amplificador</b> <button class="button1" id="Ampli" onclick="swapAmpli()">%AMPLI%</button></p>
            <p style="font-family: 'Cabin Sketch'; font-size: 15px;"><b>Bluetooth</b> <button class="button1" id="Bt" onclick="swapBt()">%BT%</button></p>
        </div>
        <hr class="separator"/> 
<div class="testInput">
            <p><h2 style="font-family: 'Cabin Sketch';">Selector de fuente de audio</h2></p>
            <p><button class="button" id="PC" onclick="setOption('PC')">PC</button><button class="button" id="Bluetooth" onclick="setOption('Bluetooth')">Bluetooth</button><button class="button" id="Aux input I" onclick="setOption('Aux input I')">Aux input I</button><button class="button" id="Aux input II" onclick="setOption('Aux input II')">Aux input II</button></p>
        </div>
        <hr class="separator"/> 
    </div>
    </div>
</body>
<script>
function swapAmpli() {
  var xhttp = new XMLHttpRequest();
  xhttp.onreadystatechange = function() {
    if (this.readyState == 4 && this.status == 200) {
      if(document.getElementById("Ampli").innerHTML == "OFF"){
          document.getElementById("Ampli").innerHTML = "ON";
          document.getElementById("Ampli").className = "button2";
      }else{
          document.getElementById("Ampli").innerHTML = "OFF";
          document.getElementById("Ampli").className = "button1";
      }
    }
  };
  xhttp.open("GET", "swapAmpli?Ampli="+document.getElementById("Ampli").innerHTML, true);
  xhttp.send();
}
function swapBt() {
  var xhttp = new XMLHttpRequest();
  xhttp.onreadystatechange = function() {
    if (this.readyState == 4 && this.status == 200) {
      if(document.getElementById("Bt").innerHTML == "OFF"){
          document.getElementById("Bt").innerHTML = "ON";
          document.getElementById("Bt").className = "button2";
      }else{
          document.getElementById("Bt").innerHTML = "OFF";
          document.getElementById("Bt").className = "button1";
      }
    }
  };
  xhttp.open("GET", "swapBt?Bt="+document.getElementById("Bt").innerHTML, true);
  xhttp.send();
}
function setOption(opt) {
  button = document.getElementById(opt);
  var xhttp = new XMLHttpRequest();
  xhttp.onreadystatechange = function() {
    if (this.readyState == 4 && this.status == 200) {

      document.getElementById("PC").className = "button";
      document.getElementById("Bluetooth").className = "button";
      document.getElementById("Aux input I").className = "button";
      document.getElementById("Aux input II").className = "button";
  
      document.getElementById(opt).className = "button2";

    }
  };
  xhttp.open("GET", "changeDevice?Option="+opt, true);
  xhttp.send();
  }
setInterval(function ( ) {
  var xhttp = new XMLHttpRequest();
  xhttp.onreadystatechange = function() {
    if (this.readyState == 4 && this.status == 200) {
      document.getElementById("Ampli").innerHTML = this.responseText;
      if(this.responseText == "ON"){
                document.getElementById("Ampli").className = "button2";
      }else{
                document.getElementById("Ampli").className = "button1";
      }
    }
  };
  xhttp.open("GET", "/Amplificador", true);
  xhttp.send();
}, 1000 ) ;

setInterval(function ( ) {
  var xhttp = new XMLHttpRequest();
  xhttp.onreadystatechange = function() {
    if (this.readyState == 4 && this.status == 200) {
      document.getElementById("Bt").innerHTML = this.responseText;
      if(this.responseText == "ON"){
                document.getElementById("Bt").className = "button2";
      }else{
                document.getElementById("Bt").className = "button1";
      }
    }
  };
  xhttp.open("GET", "/Bluetooth", true);
  xhttp.send();
}, 1000 ) ;

setInterval(function ( ) {
  var xhttp = new XMLHttpRequest();
  xhttp.onreadystatechange = function() {
    if (this.readyState == 4 && this.status == 200) {
    
      document.getElementById("PC").className = "button";
      document.getElementById("Bluetooth").className = "button";
      document.getElementById("Aux input I").className = "button";
      document.getElementById("Aux input II").className = "button";
      
      document.getElementById(this.responseText).className = "button2";

    }
  };
  xhttp.open("GET", "/Devices", true);
  xhttp.send();
}, 1000 ) ;
</script>
</html>)rawliteral";

// Replaces placeholder with DHT values
String processor(const String& var){
  //Serial.println(var);
  if(var == "AMPLI"){
    return String(ampli);
  }
  else if(var == "BT"){
    return String(bt);
  }
  return String();
}
void handleAmpli(AsyncWebServerRequest *request) {
 String option = request->arg("Ampli"); 
 if (option == "OFF") {
  digitalWrite(Ampli, HIGH);
  ampli = "ON";
 }else{ 
  digitalWrite(Ampli, LOW);
  ampli = "OFF";
 }
 change = true;
 request->redirect("/");
}

void handleBt(AsyncWebServerRequest *request) {
 String option = request->arg("Bt"); 
 if (option == "OFF") {
  digitalWrite(Bt, HIGH);
  bt = "ON";
 }else{ 
  digitalWrite(Bt, LOW);
  bt = "OFF";
 }
 change = true;
 request->redirect("/");
}
void handleDevice(AsyncWebServerRequest *request) {
 String option = request->arg("Option"); 
 if (option == "PC") {
  digitalWrite(A, LOW);
  digitalWrite(B, LOW);
 }else if(option == "Bluetooth"){
  digitalWrite(A, HIGH);
  digitalWrite(B, LOW);
 }else if(option == "Aux input I"){
  digitalWrite(A, LOW);
  digitalWrite(B, HIGH);
 }else if(option == "Aux input II"){
  digitalWrite(A, HIGH);
  digitalWrite(B, HIGH);
 }
 device = option;
 change = true;
 request->redirect("/");

}
void handleBtn(String btn){
  if(btn == "Ampli"){
    if (ampli == "OFF") {
      digitalWrite(Ampli, HIGH);
      ampli = "ON";
    }else{ 
      digitalWrite(Ampli, LOW);
      ampli = "OFF";
    }
    change = true;
  
  }
  else if(btn == "Bt"){
    if (bt == "OFF") {
      digitalWrite(Bt, HIGH);
      bt = "ON";
    }else{ 
      digitalWrite(Bt, LOW);
      bt = "OFF";
    }
    change = true;
    
  }
  else if(btn == "Device"){
    if (device == "PC") {
      device = "Bluetooth";
      digitalWrite(A, HIGH);
      digitalWrite(B, LOW);
    }else if(device == "Bluetooth"){
      device = "Aux input I";
      digitalWrite(A, LOW);
      digitalWrite(B, HIGH);
    }else if(device == "Aux input I"){
      device = "Aux input II";
      digitalWrite(A, HIGH);
      digitalWrite(B, HIGH);
    }else if(device == "Aux input II"){
      device = "PC";
      digitalWrite(A, LOW);
      digitalWrite(B, LOW);
    } 
    change = true;
  }
}
void updateDisplay(){
  display.clearDisplay();
  // Scroll part of the screen
  display.setCursor(6,3);
  display.setTextColor(WHITE);
  display.setTextSize(1);
  display.println("Configuracion actual");
  display.setCursor(6,0);
  display.drawRect(0, 0, 128, 13, WHITE);
  display.setTextColor(WHITE);
  display.setCursor(6,15);
  display.print("Amplificador:");
  display.setTextColor(BLACK, WHITE);
  display.print(ampli);
  display.setCursor(6,25);
  display.setTextColor(WHITE);
  display.print("Bluetooth:");
  display.setTextColor(BLACK, WHITE);
  display.print(bt);
  display.setCursor(6,35);
  display.setTextColor(WHITE);
  display.print("Entrada:");
  display.setTextColor(BLACK, WHITE);
  display.print(device);
  display.setTextColor(WHITE);
  display.setCursor(6,45);
  display.print("WiFi: ");
  display.print(ssid);
  display.setCursor(6,55);
  display.print("IP: ");
  display.println(WiFi.localIP()); 
  display.display();
  }
void setup(){

  pinMode(Ampli, OUTPUT);
  pinMode(Bt,OUTPUT);
  pinMode(A,OUTPUT);
  pinMode(B,OUTPUT);

  pinMode(btn_ampli,INPUT);
  pinMode(btn_bt,INPUT);
  pinMode(btn_device,INPUT);

  digitalWrite(A, LOW);
  digitalWrite(B, LOW);
  digitalWrite(Ampli, LOW);
  digitalWrite(Bt, LOW);

  WiFi.begin(ssid, password);
  while (WiFi.status() != WL_CONNECTED) {
    delay(500);
  }
  display.begin(SSD1306_SWITCHCAPVCC, 0x3C);  
  display.clearDisplay();
  display.drawBitmap(0, 0,  CrayfeLogo, 128, 64, WHITE);
  display.display();
  delay(3000);
  updateDisplay();
  
  // Route for root / web page
  server.on("/", HTTP_GET, [](AsyncWebServerRequest *request){
    request->send_P(200, "text/html", index_html, processor);
  });
  server.on("/Amplificador", HTTP_GET, [](AsyncWebServerRequest *request){
    request->send_P(200, "text/plain", String(ampli).c_str());
  });
  server.on("/Bluetooth", HTTP_GET, [](AsyncWebServerRequest *request){
    request->send_P(200, "text/plain", String(bt).c_str());
  });
  server.on("/Devices", HTTP_GET, [](AsyncWebServerRequest *request){
    request->send_P(200, "text/plain", String(device).c_str());
  });
  server.on("/swapAmpli", HTTP_GET, handleAmpli);
  server.on("/swapBt", HTTP_GET, handleBt);
  server.on("/changeDevice", HTTP_GET, handleDevice);
  // Start server
  server.begin();
}
 
void loop(){
    if(change){
      updateDisplay();
      change = false;
    }
    if(digitalRead(btn_ampli) == HIGH){
      handleBtn("Ampli");
      delay(200);
      
    }else if(digitalRead(btn_bt) == HIGH){
      handleBtn("Bt");
      delay(200);
    }else if(digitalRead(btn_device) == HIGH){
      handleBtn("Device");
      delay(200);
    }
}
